## drivers/input/fingerprint/Kconfig
```kconfig
#
#Fingerprint
#
menu "Fingerprint support"
	depends on INPUT

config MTK_FINGERPRINT_SUPPORT
	bool "Mediatek Fingerprint"
	default n
	help
	  Fingerprint mtk driver enable/disable in the kernel.
	  Say Y here if you want to use mediatek fingerprint driver,
	  fingerprint driver will support fingerprint function

if MTK_FINGERPRINT_SUPPORT
config FPC_FINGERPRINT
	bool "FPC Fingerprint"
	default n
	help
	  FPC fingerprint FPC's 102x/104x device.

config GOODIX_FINGERPRINT
	bool "Goodix Fingerprint"
	default n
	help
	  Goodix Fingerprint chip GF316M/GF318M/GF3118M/GF518M/GF5118M/GF516M/GF816M/GF3208/GF3206/
	  GF3266/GF3288/GF5206/GF5216/GF5208 TEE driver
endif
endmenu
```

## drivers/misc/mediatek/lens/Kconfig
```kconfig
config MTK_LENS
	bool CONFIG_MTK_LENS
	default n
	help
	  CONFIG_MTK_LENS

config MTK_LENS_MAIN
	bool CONFIG_MTK_LENS_MAIN
	depends on MTK_LENS
	default n
	help
	  CONFIG_MTK_LENS_MAIN

config MTK_LENS_MAIN2
	bool CONFIG_MTK_LENS_MAIN2
	depends on MTK_LENS
	default n
	help
	  CONFIG_MTK_LENS_MAIN2

config MTK_LENS_MAIN3
	bool CONFIG_MTK_LENS_MAIN3
	depends on MTK_LENS
	default n
	help
	  CONFIG_MTK_LENS_MAIN3

config MTK_LENS_SUB
	bool CONFIG_MTK_LENS_SUB
	depends on MTK_LENS
	default n
	help
	  CONFIG_MTK_LENS_SUB

config MTK_LENS_SUB2
	bool CONFIG_MTK_LENS_SUB2
	depends on MTK_LENS
	default n
	help
	  CONFIG_MTK_LENS_SUB2

config MTK_LENS_USE_MODULE
	bool "Mediatek lens driver build as module"
	default n
	help
	  Say Y here if you want to build touch driver as xxx.ko.

	  If unsure, say N.

	  To compile this dirver as a module,
	  It will be called by insmod xxx.ko in init.rc.

#
# LENS
#

config MTK_LENS_CACTUS_DW9714AF_OFILM_SUPPORT
	bool "CACTUS DW9714AF OFILM Lens Driver"
	depends on MTK_LENS_MAIN
	default n
	help
	  CACTUS DW9714AF OFILM Lens Driver
	  This config is used to enable the corresponding
	  lens driver for the camera sensor module
	  Set as y if the driver is used in this project

config MTK_LENS_CACTUS_FP5510E2AF_SUNNY_SUPPORT
	bool "CACTUS FP5510E2AF SUNNY Lens Driver"
	depends on MTK_LENS_MAIN
	default n
	help
	  CACTUS FP5510E2AF SUNNY Lens Driver
	  This config is used to enable the corresponding
	  lens driver for the camera sensor module
	  Set as y if the driver is used in this project

config MTK_LENS_CEREUS_DW9714AF_OFILM_SUPPORT
	bool "CEREUS DW9714AF OFILM Lens Driver"
	depends on MTK_LENS_MAIN
	default n
	help
	  CEREUS DW9714AF OFILM Lens Driver
	  This config is used to enable the corresponding
	  lens driver for the camera sensor module
	  Set as y if the driver is used in this project

config MTK_LENS_CEREUS_DW9714AF_SUNNY_SUPPORT
	bool "CEREUS DW9714AF SUNNY Lens Driver"
	depends on MTK_LENS_MAIN
	default n
	help
	  CEREUS DW9714AF SUNNY Lens Driver
	  This config is used to enable the corresponding
	  lens driver for the camera sensor module
	  Set as y if the driver is used in this project
```

## drivers/misc/mediatek/ram_console/Kconfig
```kconfig
config MTK_RAM_CONSOLE
	bool "mt ram console"
	help
	  ram_console is a feature which will record some
	  debug information and can be read after reboot.
	  It can be configured as SRAM or DRAM.
	  Each ram type should be set address and size.

config MTK_RAM_CONSOLE_LEGACY_BOOTLOADER
	bool "mt legacy bootloader ram console"
	depends on MTK_RAM_CONSOLE

config MTK_RAM_CONSOLE_USING_SRAM
	bool "Using SRAM as ram console storage"
	depends on MTK_RAM_CONSOLE_LEGACY_BOOTLOADER
	help
	  If set this config as yes, ram_console will use
	  SRAM as its storage, all ram_console content
	  will write into SRAM.
	  You should set SRAM address and size as belows.

config MTK_RAM_CONSOLE_USING_DRAM
	bool "Using DRAM as ram console storage"
	depends on MTK_RAM_CONSOLE_LEGACY_BOOTLOADER
	help
	  If set this config as yes, ram_console will use
	  DRAM as its storage, all ram_console content
	  will write into DRAM.
	  You should set DRAM address and size as belows.

config MTK_RAM_CONSOLE_SRAM_ADDR
	hex "MTK RAM console sram addres"
	default 0
	depends on MTK_RAM_CONSOLE_USING_SRAM
	help
	  SRAM ram_console address.

config MTK_RAM_CONSOLE_SRAM_SIZE
	hex "MTK RAM console sram size"
	default 0
	depends on MTK_RAM_CONSOLE_USING_SRAM
	help
	  SRAM ram_console memory allocate size.

config MTK_RAM_CONSOLE_DRAM_ADDR
	hex "MTK RAM console dram addres"
	default 0
	depends on MTK_RAM_CONSOLE_USING_DRAM
	help
	  DRAM ram_console address.

config MTK_RAM_CONSOLE_DRAM_SIZE
	hex "MTK RAM console dram size"
	default 0
	depends on MTK_RAM_CONSOLE_USING_DRAM
	help
	  DRAM ram_console memory allocate size.

config MTK_RAM_CONSOLE_PSTORE_ADDR
	hex "MTK RAM console pstore addres"
	default 0
	depends on MTK_RAM_CONSOLE_LEGACY_BOOTLOADER
	help
	  PSTORE ram_console address.

config MTK_RAM_CONSOLE_PSTORE_SIZE
	hex "MTK RAM console pstore size"
	default 0
	depends on MTK_RAM_CONSOLE_LEGACY_BOOTLOADER
	help
	  PSTORE ram_console memory allocate size.

config MTK_RAM_CONSOLE_MRDUMP_ADDR
	hex "MTK RAM console mrdump addres"
	default 0
	depends on MTK_RAM_CONSOLE_LEGACY_BOOTLOADER
	help
	  MRDUMP ram_console address.

config MTK_RAM_CONSOLE_MRDUMP_SIZE
	hex "MTK RAM console mrdump size"
	default 0
	depends on MTK_RAM_CONSOLE_LEGACY_BOOTLOADER
	help
	  MRDUMP ram_console memory allocate size.
```

## drivers/misc/mediatek/sensors-1.0/accelgyro/Kconfig
```kconfig
config MTK_AUTO_DETECT_ACCELGYRO
	bool "MTK AUTO DETECT ACCELEGYRO Sensor"
	depends on MTK_SENSOR_SUPPORT
	help
	  one load to support different accelerometer and gyro sensor.
	  If this option is set, multiple accelerometer and gyro driver
	  can be configured at the same time, but only one
	  can be probed.

config CUSTOM_KERNEL_ACCELGYRO
	bool "CUSTOM KERNEL ACCELGYRO Config"
	help
	  accelgyro sensor provides precise acceleration
	  and angular rate (gyroscopic) measurement.
```

## drivers/misc/mediatek/sensors-1.0/high_freq_sensor/Kconfig
```kconfig
config MTK_HIGH_FREQ_SENSOR
	bool "MTK HIGH FREQUENCY SENSOR Config"
	help
	  high frequency sensor is an architecture to detect
	  sensor raw data. If the platform is supported for high
	  frequency sensor, this configuration should be configured,
	  and the subdevice driver configuration should be configured as well.
```
